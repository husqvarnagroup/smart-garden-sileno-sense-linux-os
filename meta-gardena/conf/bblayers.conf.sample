## meta-gardena/conf/bblayers.conf.sample
```bitbake
# LAYER_CONF_VERSION is increased each time build/conf/bblayers.conf
# changes incompatibly
LCONF_VERSION = "7"

BBPATH = "${TOPDIR}"
BBFILES ?= ""

BBLAYERS ?= " \
  ##OEROOT##/meta \
  ##OEROOT##/../meta-openembedded/meta-oe \
  ##OEROOT##/../meta-openembedded/meta-networking \
  ##OEROOT##/../meta-openembedded/meta-python \
  ##OEROOT##/../meta-openembedded/meta-filesystems \
  ##OEROOT##/../meta-clang \
  ##OEROOT##/../meta-tegra \
  ##OEROOT##/../meta-gardena \
  ##OEROOT##/../meta-ptx \
  ##OEROOT##/../meta-swupdate \
  "
```

## meta-gardena/conf/distro/gardena.conf
```bitbake
DISTRO = "gardena"
MAINTAINER = "Gardena <smart.open.source@husqvarnagroup.com>"
DISTRO_NAME = "gardena"
DISTRO_VERSION = "6.2.3"

# Keeping the old name for backwards compatibility, should rather be "-gardenasdk"
SDK_VENDOR = "-pokysdk"
SDK_VERSION := "${@'${DISTRO_VERSION}'.replace('snapshot-${DATE}','snapshot')}"
SDK_VERSION[vardepvalue] = "${SDK_VERSION}"

DISTRO_FEATURES:remove = " x11 vulkan nfs nfc zeroconf pcmcia acl irda python python3 ptest bluetooth 3g ipv6 ppp selinux smbfs"
DISTRO_FEATURES:append = " opengl"

INIT_MANAGER = "systemd"

INHERIT += "rm_work buildhistory"
BUILDHISTORY_COMMIT = "1"

LICENSE_FLAGS_ACCEPTED = "commercial"
HOSTTOOLS += "git-lfs"
EXTRA_IMAGE_FEATURES = ""

BBMASK = "boost-url"

SDK_NAME = "${DISTRO}-${TCLIBC}-${SDKMACHINE}-${IMAGE_BASENAME}-${TUNE_PKGARCH}-${MACHINE}"
SDKPATHINSTALL = "/opt/${DISTRO}/${SDK_VERSION}"

TCLIBCAPPEND = ""

SANITY_TESTED_DISTROS += " \
            debian-13 \n \
            linuxmint-20 \n \
            linuxmint-20.2 \n \
            linuxmint-20.3 \n \
            linuxmint-21 \n \
            linuxmint-21.1 \n \
            linuxmint-21.2 \n \
            linuxmint-21.3 \n \
            ubuntu-24.04 \n \
            "

require conf/distro/include/no-static-libs.inc
require conf/distro/include/yocto-uninative.inc
require conf/distro/include/security_flags.inc
INHERIT += "uninative"

TOOLCHAIN_HOST_TASK:append = " nativesdk-protobuf nativesdk-protobuf-compiler nativesdk-ninja nativesdk-cmake "
TOOLCHAIN_HOST_TASK:remove = " systemd"

#cuda
TOOLCHAIN_TARGET_TASK:append =" cuda-libraries"
TOOLCHAIN_HOST_TASK:append  = " nativesdk-cuda-compiler nativesdk-cuda-cudart"
TOOLCHAIN_TARGET_TASK:append = " cuda-nvrtc  cuda-nvrtc"

#core
TOOLCHAIN_TARGET_TASK:append =" boost"
TOOLCHAIN_TARGET_TASK:append =" spdlog libarchive libq  "
TOOLCHAIN_TARGET_TASK:append =" aaplus clipper "
TOOLCHAIN_TARGET_TASK:append =" libunwind "
TOOLCHAIN_TARGET_TASK:append =" cuda-nvrtc tegra-tools tensorrt-trtexec tegra-tools tegra-libraries-cuda tegra-libraries-core"

#networking
TOOLCHAIN_TARGET_TASK:append =" cpr libnl libdatachannel protobuf"

#detection
TOOLCHAIN_TARGET_TASK:append =" opencv point-cloud-library ompl sbpl fbow"
TOOLCHAIN_TARGET_TASK:append =" tensorrt-core tensorrt-plugins tegra-mmapi"

#hardware
TOOLCHAIN_TARGET_TASK:append = " libgpiod"

#polkit
DISTRO_FEATURES:append = " polkit"

# Do not use "patched" (the default), as we must not distribute modified
# versions of AA+!
ARCHIVER_MODE[src] = "original"
```

## meta-gardena/conf/machine/gardena-jetson-nano.conf
```bitbake
require conf/machine/jetson-nano-devkit-emmc.conf

IMAGE_CLASSES += "image_types_tegra_custom"
IMAGE_FSTYPES = "tegraflash"

CUDA_VERSION = "10.2"
#For the kernel compilation
HOSTTOOLS += "xxd bc"

ROOTFSPART_SIZE = "2147483648"

NVIDIA_DEVNET_MIRROR = "file:///${HOME}/nvidia/nvidia_sdk"

MACHINE_FEATURES_BACKFILL_CONSIDERED:append = " qemu-usermode"

RM_WORK_EXCLUDE:append = " linux-tegra u-boot-tegra"

KERNEL_DEVICETREE = "tegra210-p3448-0002-p3449-0000-b00.dtb"
```

## meta-gardena/recipes-support/swupdate/swupdate/defconfig
```kconfig
CONFIG_SYSTEMD=y
CONFIG_SOCKET_CTRL_PATH="/tmp/sockinstctrl"
CONFIG_SOCKET_PROGRESS_PATH="/tmp/swupdateprog"
# CONFIG_BOOTLOADER_NONE is not set
CONFIG_UBOOT=y
CONFIG_WEBSERVER=y
CONFIG_HASH_VERIFY=y
CONFIG_ARCHIVE=y
# CONFIG_LOCALE is not set
CONFIG_BOOTLOADERHANDLER=y
CONFIG_DISKPART=y
CONFIG_RAW=y
CONFIG_SHELLSCRIPTHANDLER=y
CONFIG_LUA=n
CONFIG_MTD=n
```
